## arch/arm/common/Kconfig
```kconfig
config ARCH_ARM_USE_GIC
    bool
    default n

config ARCH_ARM_USE_NVIC
    bool
    default n
    
```

## arch/arm/mach/stm32/Kconfig
```kconfig
comment "STM32 Platform Options"

config MACH_STM32_PLATFORM
	bool
	default y
    select LINKER_MACH_BSS_SECTION_IN_SRAM
	select ARCH_ARM_CORTEX_M3
	select ARCH_ARM_USE_NVIC

config ARCH_ARM_SYSTICK_SRC0_DIV
    int
    default 8
	
config ARCH_ARM_NVIC_TOTAL_IRQS
	int
	default 255
	
config MACH_PRIORITY_BITS
	int
	default 3

choice
	prompt "systick clock source"
	default MACH_STM32_SYSTICK_PROCESSOR_CLOCK

config MACH_STM32_SYSTICK_PROCESSOR_CLOCK
	bool "processor clock"

config MACH_STM32_SYSTICK_EXTERNAL_CLOCK
	bool "processor/2 clock"

endchoice

config ARCH_ARM_SYSTICK_CLKSRC
	hex
	default 0x00 if MACH_STM32_SYSTICK_EXTERNAL_CLOCK
	default 0x04 if MACH_STM32_SYSTICK_PROCESSOR_CLOCK


#
#	This needs to be changed dependent on the chip variant.
#
config MACH_STM32_TOTAL_GPIOS
    int
	default 80

#
#	These have been added here as quick hacks.
#
config MACH_STM32_GPIO_BASE
    hex
	default 0x40010800
```
